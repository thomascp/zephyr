/* SPDX-License-Identifier: Apache-2.0 */

/dts-v1/;

#include <riscv64-fu540.dtsi>

/ {
	model = "SiFive HiFive Unleashed";
	compatible = "sifive,unleashed";
	aliases {
	};

	chosen {
		zephyr,console = &uart0;
		zephyr,shell-uart = &uart0;
	};
};

&uart0 {
	status = "ok";
	current-speed = <115200>;
	clock-frequency = <16666666>;
};

