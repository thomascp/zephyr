## boards/riscv/hifive_unleashed/Kconfig.board
```kconfig
# SPDX-License-Identifier: Apache-2.0

config BOARD_HIFIVE_UNLEASHED
	bool "HiFive Unleashed target"
	depends on SOC_RISCV64_SIFIVE_FREEDOM
```

## boards/riscv/hifive_unleashed/Kconfig.defconfig
```kconfig
# SPDX-License-Identifier: Apache-2.0

if BOARD_HIFIVE_UNLEASHED

config BOARD
	default "hifive_unleashed"

endif
```

## boards/riscv/hifive_unleashed/hifive_unleashed_defconfig
```kconfig
# SPDX-License-Identifier: Apache-2.0

CONFIG_RISCV=y
CONFIG_RISCV64=y
CONFIG_SOC_SERIES_RISCV64_SIFIVE_FREEDOM=y
CONFIG_SOC_RISCV64_SIFIVE_FREEDOM=y
CONFIG_BOARD_HIFIVE_UNLEASHED=y
CONFIG_CONSOLE=y
CONFIG_PRINTK=y
CONFIG_SERIAL=y
CONFIG_UART_SIFIVE=y
CONFIG_UART_SIFIVE_PORT_0=y
CONFIG_UART_CONSOLE=y
CONFIG_RISCV_MACHINE_TIMER=y
CONFIG_BOOT_BANNER=y
```

## soc/riscv/riscv-privilege/hifive-freedom/Kconfig.defconfig.series
```kconfig
# SPDX-License-Identifier: Apache-2.0

if SOC_SERIES_RISCV64_SIFIVE_FREEDOM

config SOC_SERIES
	string
	default "hifive-freedom"

config SYS_CLOCK_HW_CYCLES_PER_SEC
	int
	default 1000000

config RISCV_SOC_INTERRUPT_INIT
	bool
	default y

config RISCV_HAS_CPU_IDLE
	bool
	default y

config RISCV_HAS_PLIC
	bool
	default y

config NUM_IRQS
	int
	default 64

config XIP
	bool
	default n

config RISCV_RAM_BASE_ADDR
	hex
	default	0x20000000

config RISCV_RAM_SIZE
	hex
	default 0x10000000

config SMP
	default y

config USE_SWITCH
	default y

endif # SOC_SERIES_RISCV64_SIFIVE_FREEDOM
```

## tests/benchmarks/sys_kernel/testcase.yaml
```yaml
tests:
  benchmark.kernel:
    arch_exclude: nios2 riscv xtensa x86_64
    min_ram: 32
    tags: benchmark
```

## tests/kernel/profiling/profiling_api/testcase.yaml
```yaml
tests:
  kernel.profiling:
    arch_exclude: nios2 riscv
    platform_exclude: em_starterkit
    tags: kernel
```
